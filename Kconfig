## Kconfig
```kconfig
config ZMK_INPUT_PROCESSOR_GESTURE_NAV
    bool "Gesture navigation input processor (pointer swipe -> behaviors)"
    default y
    depends on DT_HAS_ZMK_INPUT_PROCESSOR_GESTURE_NAV_ENABLED
    # ビヘイビアのキュー(behavior_queue.c)は親機でしかビルドされない。
    # トラックボールは右手=親機にあるので、子機(左手)では無効にしておく。
    depends on !ZMK_SPLIT || ZMK_SPLIT_ROLE_CENTRAL
```

## config/west.yml
```yaml
manifest:
  remotes:
    - name: cormoran
      url-base: https://github.com/cormoran
    - name: inorichi
      url-base: https://github.com/inorichi
    - name: Ziembski
      url-base: https://github.com/Ziembski
    - name: caksoylar
      url-base: https://github.com/caksoylar
    - name: tom0rrowi54n0therd4y0l26-hash
      url-base: https://github.com/tom0rrowi54n0therd4y0l26-hash
  projects:
    - name: zmk
      remote: cormoran
      revision: main+dya
      import: app/west.yml
    - name: zmk-module-ble-management
      remote: cormoran
      revision: main
    - name: zmk-module-battery-history
      remote: cormoran
      revision: main
    - name: zmk-module-settings-rpc
      remote: cormoran
      revision: main
    - name: zmk-module-runtime-input-processor
      remote: cormoran
      revision: main
    - name: zmk-feature-custom-settings
      remote: tom0rrowi54n0therd4y0l26-hash
      revision: main # fork of cormoran/zmk-feature-custom-settings with the Kconfig "configdefault" syntax-error fixed
    - name: zmk-pmw3610-driver
      remote: Ziembski
      # Zephyr 4.1のネイティブpixart,pmw3610ドライバとの衝突を避けるため、
      # compatible/Kconfigをpmw3610-ino系にリネームしたfork。
      # このforkのmainブランチにはリネームが入っていない(revert済み)ので、
      # 修正が入っているupdate-to-mainブランチの該当コミットを直接指定する。
      revision: 05a27a9447f438ce173941c72ce24d6b80bdee77
    - name: zmk-rgbled-widget
      remote: caksoylar
      revision: main
  self:
    path: config
```

## dts/bindings/input_processors/zmk,input-processor-gesture-nav.yaml
```yaml
description: |
  ポインタの横移動を積算し、しきい値を超えたらビヘイビアを1回発火する入力プロセッサ。
  bindings[0] = 左へ動かしたとき、bindings[1] = 右へ動かしたとき。
  処理中のポインタ移動は打ち消す(カーソルは動かない)。

compatible: "zmk,input-processor-gesture-nav"

include: ip_zero_param.yaml

properties:
  bindings:
    type: phandle-array
    required: true
    description: 左方向・右方向で発火するビヘイビア(この順で2つ)

  threshold:
    type: int
    default: 150
    description: 発火に必要な横方向の移動量(センサーのカウント数)

  cooldown-ms:
    type: int
    default: 400
    description: 発火後、次の発火を受け付けない時間

  idle-reset-ms:
    type: int
    default: 200
    description: この時間動きが無ければ積算をリセット(わずかなブレの蓄積防止)

  tap-ms:
    type: int
    default: 30
    description: 発火時にビヘイビアを押している時間
```
